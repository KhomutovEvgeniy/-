#include <CMSIS/stm32f10x.h>
#include "stm32f10x_gpio.h"
#include "stm32f10x_rcc.h"
#include "math.h"


/*
Используется TIM2 CHANNEL 2.
Используется TIM3.
Используется TIM4.
Использую PA1 вместо PC8.

Частоту ШИМа я взял 160 кГц.

Использую второй таймер для задания частоты дискретизации.

Использую третий таймер для небольшой паузы между проигрыванием звука.

У меня имеется wav файл. С помощью специальной программы я посмотрю структуру этого файла, чтобы узнать необходимую про него информацию:
-Разрадность выборки: 8 бит.
-Частота дискретизации: 8 000 Гц

Также с 44 байта я считываю байты области данных, записываю их в массив, а затем записываю в регистр заполнения ШИМа ССR.

Пришлось сильно обрезать файл.
*/

#define PWM_PRESCALER 0
#define PWM_PERIOD 450                                      // частота ШИМа: 72 000 000/450 = 160 000 = 160 кГц   

#define TIMER_PERIOD 9000                  							    // значения частоты дискретизации(количество тиков) для таймера, обеспечивающего задержку. 72 000 000/9 000  = 8 000 Гц = 125 мкс = 0,125 мс

#define Timer_PRESCALER 7200                                // значения предделителя для таймера, обеспечивающего паузу между проигрыванием файла. 72 000 000/7200 = 10 000 Гц.
#define Timer_PERIOD 20000                  							  // значения периода(количество тиков) для таймера, обеспечивающего паузу. 10 000/20 000 = 1 Гц. 1 Гц = 2 с

#define PORT_MANAGE_DYN GPIOA
#define PIN_MANAGE_DYN GPIO_Pin_1

// типовой вариант функции assert
void assert_failed(uint8_t* file, uint32_t line)
{ 
  while (1)
  {
	;
  }
}


const uint16_t wav[] = {
	0x7A,0x82,0xAA,0x80,0x78,0x88,0x5E,0x86,0x76,0x7E,0xB4,0x78,0x7E,0x86,0x4E,0x8A,0x72,0x74,0xAE,0x6E,0x90,
	0x80,0x48,0x88,0x6E,0x74,0x98,0x6E,0x96,0x78,0x4C,0x92,0x72,0x7C,0x7E,0x78,0x8E,0x86,0x62,0x94,0x7C,0x80,
	0x54,0x90,0x5C,0x82,0x8E,0x7E,0x9E,0x72,0x4A,0x92,0x6C,0x62,0xC0,0x80,0x94,0x78,0x5A,0x80,0x8A,0x76,0xC6,
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	0x80,0x84,0x88,0x88,0x7E,0x80,0x86,0x88,0x82,0x7A,0x6C,0x60,0x4C,0x50,0x62,0x8E,0x9C,0x88,0x7E,0x7E,0x80,
	};
	
void Set_Pin()                                               // настройка подключения периферии
{
	RCC_APB2PeriphClockCmd(RCC_APB2Periph_GPIOA , ENABLE);     // тактирую порт А
	
  GPIO_InitTypeDef gpioStruct;                               // структура сигнального пина
  GPIO_StructInit(&gpioStruct);
	gpioStruct.GPIO_Speed = GPIO_Speed_2MHz;
	gpioStruct.GPIO_Mode = GPIO_Mode_AF_PP;                    // буду использовать альтернативный режим, а не обычный GPIO
	gpioStruct.GPIO_Pin = PIN_MANAGE_DYN;                      // настроим ногу (PА1) к которой подключен динамик
  GPIO_Init(PORT_MANAGE_DYN, &gpioStruct);
}

void Set_Timer()
{
	// настройка базового таймера
	RCC_APB1PeriphClockCmd(RCC_APB1Periph_TIM2, ENABLE);       // тактирую таймер 2
	RCC_APB1PeriphClockCmd(RCC_APB1Periph_TIM3, ENABLE);       // тактирую таймер 3
	RCC_APB1PeriphClockCmd(RCC_APB1Periph_TIM4, ENABLE);       // тактирую таймер 3
                                                             
	TIM_TimeBaseInitTypeDef Tim;                               // создаю экземпляр структуры, которая задает частоту через предделитель, период и направление счета
  TIM_TimeBaseStructInit(&Tim);                              // заполняю структуру значениями по умолчанию
	Tim.TIM_Prescaler = PWM_PRESCALER;                         // предделитель для таймера
	Tim.TIM_Period = PWM_PERIOD;                               // период 
	TIM_TimeBaseInit(TIM2, &Tim);                              // инициализирую таймер
                       
	Tim.TIM_Period = TIMER_PERIOD;        										            
	TIM_TimeBaseInit(TIM3, &Tim);  
	
	Tim.TIM_Prescaler = Timer_PRESCALER;                                   
	Tim.TIM_Period = Timer_PERIOD;                          
	TIM_TimeBaseInit(TIM4, &Tim);  
	
	// настройка канала ШИМа
	TIM_OCInitTypeDef TimPWM;                                  // конфигурация выхода таймера. Структура для генерации ШИМ
	TIM_OCStructInit(&TimPWM);
	TimPWM.TIM_OCMode = TIM_OCMode_PWM1;                       // конфигурируем выход таймера, режим PWM1 
	TimPWM.TIM_OutputState = TIM_OutputState_Enable;           // выход включен
	TIM_OC2Init(TIM2, &TimPWM);                                // заношу данные во 2ой канал
	
	TIM_ITConfig(TIM2,TIM_IT_Update, ENABLE);                  // режим генерации прерывания по обновлению, переполнению
	TIM_ITConfig(TIM3,TIM_IT_Update, ENABLE);   
	TIM_ITConfig(TIM4,TIM_IT_Update, ENABLE);   
	TIM_Cmd(TIM2, ENABLE);                                     // запуск таймера
}

void Delay()                           			                 // функция, обеспечивающая задержку.
{ 	    
	TIM_Cmd(TIM3, ENABLE);         														 // в момент вызова произвести запуск таймера
	while((TIM3->SR & TIM_SR_UIF)==0)                          //дождаться конца задержки
	{
	}		
  TIM_ClearITPendingBit(TIM3,TIM_IT_Update);	               //сбросить флаг
}

void Wait()                           											 // функция, обеспечивающая паузу в 2 с.
{
	TIM_Cmd(TIM4, ENABLE);         														 
	while((TIM4->SR & TIM_SR_UIF)==0)                          
	{
	}		
  TIM_ClearITPendingBit(TIM4,TIM_IT_Update);	              
}

void WAV()
{    				 
	for(int i = 0; i <= 13335; i++)                              
	{                                        
		TIM2->CCR2 = wav[i];                
    Delay();		                           
	}
	Wait();
}

int main()
{
	Set_Pin();
	Set_Timer();
	while(1)
	{
		WAV();
	}
	return 0;
}
	